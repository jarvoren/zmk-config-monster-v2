## boards/shields/monster/Kconfig.defconfig
```kconfig
if SHIELD_MONSTER_LEFT

config ZMK_KEYBOARD_NAME
    default "Monster"

config ZMK_SPLIT_ROLE_CENTRAL
    default y

endif

if SHIELD_MONSTER_LEFT || SHIELD_MONSTER_RIGHT

config ZMK_SPLIT
    default y

endif

if SHIELD_MONSTER_RIGHT

config ZMK_KEYBOARD_NAME
    default "Monster Right"

endif
```

## boards/shields/monster/Kconfig.shield
```kconfig
config SHIELD_MONSTER_LEFT
    def_bool $(shields_list_contains,monster_left)

config SHIELD_MONSTER_RIGHT
    def_bool $(shields_list_contains,monster_right)
```
